## products/meeting_demo/components/volc_conv_ai/Kconfig
```kconfig
menu "Volcano Engine ConvAI Transport"

    choice VOLC_TRANSPORT_MODE
        prompt "Transport mode"
        default VOLC_RTC_MODE
        help
            Select the transport protocol for the Volcano Engine ConvAI SDK.

        config VOLC_RTC_MODE
            bool "RTC (high quality, uses libVolcEngineRTCLite.a)"

        config VOLC_WS_MODE
            bool "WebSocket (low load, pure C)"

    endchoice

endmenu
```

## products/meeting_demo/main/Kconfig.projbuild
```kconfig
menu "Meeting Demo Configuration"

    config MEETING_WIFI_SSID
        string "WiFi SSID"
        default "myssid"
        help
            WiFi network to connect to on boot.

    config MEETING_WIFI_PASSWORD
        string "WiFi Password"
        default "mypassword"

    config MEETING_CLARITYX_SERVER_URL
        string "ClarityX Server Base URL"
        default "https://ailabs.mayfair-inc.net/voice-api"
        help
            Base URL for the ClarityX meeting session API.
            createSession = this_value + "/api/session"
            endSession    = this_value + "/api/session/{id}/end"

    comment "Volcano Engine RTC credentials (required for Host Mode)"

    config MEETING_VOLC_INSTANCE_ID
        string "Volcano Engine Instance ID"
        default ""

    config MEETING_VOLC_BOT_ID
        string "Volcano Engine Bot ID"
        default ""

    config MEETING_VOLC_APP_ID
        string "Volcano Engine App ID"
        default ""

    config MEETING_VOLC_TOKEN
        string "Volcano Engine Token"
        default ""

endmenu
```

## products/rtc_meeting_demo/main/Kconfig.projbuild
```kconfig
menu "RTC Meeting Demo Configuration"

    config MEETING_WIFI_SSID
        string "WiFi SSID"
        default "myssid"
        help
            WiFi network to connect to on boot.

    config MEETING_WIFI_PASSWORD
        string "WiFi Password"
        default "mypassword"

    comment "Business server (Python RtcAigcService)"

    config AIGENT_SERVER_HOST
        string "Business Server Host (ip:port)"
        default "192.168.1.100:8080"
        help
            Host and port of the Python business server (no http:// prefix).
            Example: 192.168.1.100:8080

    comment "Volcengine RTC credentials"

    config RTC_APPID
        string "Volcengine RTC App ID"
        default ""
        help
            App ID for VolcEngineRTCLite SDK (from Volcengine RTC console).
            Also used to build the Authorization header: af78e30 + this value.

endmenu
```

## products/speaker/main/Kconfig.projbuild
```kconfig
menu "Example Configuration"

    config SPEAKER_BOOT_VOICE_PROMPTS
        bool "Enable boot voice prompts (server_connected, mic_open, mic_close)"
        default n
        help
            When enabled, the server_connected, mic_open, and mic_close audio
            prompts will play during agent lifecycle events.
            The boot.mp3 will always play regardless of this setting.

    config SPEAKER_AGENT_AUTOSTART
        bool "Enable voice agent auto-start on boot"
        default n
        help
            When enabled, the Coze agent will automatically initialize and
            connect to the server on boot.
            When disabled, the agent must be started manually.

    menu "Default WiFi Profiles"
        help
            Configure WiFi networks for auto-connect on boot.
            Networks are tried in order (AP1 first, then AP2, etc.).
            Leave SSID empty to skip a profile.

        config SPEAKER_WIFI_AP1_SSID
            string "AP1 SSID"
            default ""
        config SPEAKER_WIFI_AP1_PASSWORD
            string "AP1 Password"
            default ""

        config SPEAKER_WIFI_AP2_SSID
            string "AP2 SSID"
            default ""
        config SPEAKER_WIFI_AP2_PASSWORD
            string "AP2 Password"
            default ""

        config SPEAKER_WIFI_AP3_SSID
            string "AP3 SSID"
            default ""
        config SPEAKER_WIFI_AP3_PASSWORD
            string "AP3 Password"
            default ""
    endmenu

    config SPEAKER_WAKE_WORD_ENABLE
        bool "Enable wake word detection and touch button wake-up"
        default n
        help
            When enabled, WakeNet detection is active and the touch button
            can trigger wake-up.
            When disabled, no wake word detection or touch wake-up.

    menuconfig EXAMPLE_COZE_AGENT_ENABLE_DEFAULT_CONFIG
        bool "Default coze agent config"
        default n

    if EXAMPLE_COZE_AGENT_ENABLE_DEFAULT_CONFIG

        config EXAMPLE_COZE_AGENT_APP_ID
            string "App ID"
            default "110049xxxxxxx"

        config EXAMPLE_COZE_AGENT_PUBLIC_KEY
            string "Public key"
            default "lsKjtB67xxxxxxxxxxxxxxxxxxxxxxxxxxxxxxxxxxx"

        config EXAMPLE_COZE_AGENT_PRIVATE_KEY_FILE_PATH
            string "Private key"
            default "./private_key.pem"

        config EXAMPLE_COZE_AGENT_CUSTOM_CONSUMER
            string "Custom consumer (Optional)"
            default ""

        menuconfig EXAMPLE_COZE_AGENT_BOT1_ENABLE
            bool "Bot 1"
            default y

        if EXAMPLE_COZE_AGENT_BOT1_ENABLE
            config EXAMPLE_COZE_AGENT_BOT1_NAME
                string "Bot name"
                default "Lin Jia Nv Hai"

            config EXAMPLE_COZE_AGENT_BOT1_ID
                string "Bot ID"
                default "7516538xxxxxxxxxxxx"

            config EXAMPLE_COZE_AGENT_BOT1_DESCRIPTION
                string "Bot description"
                default "A warm-voiced female AI character who listens to the user's thoughts and offers comforting responses."

            config EXAMPLE_COZE_AGENT_BOT1_VOICE_ID
                string "Bot voice ID"
                default "7426720361733144585"
        endif

        menuconfig EXAMPLE_COZE_AGENT_BOT2_ENABLE
            bool "Bot 2"
            default y

        if EXAMPLE_COZE_AGENT_BOT2_ENABLE
            config EXAMPLE_COZE_AGENT_BOT2_NAME
                string "Bot name"
                default "Wan Qu Da Shu"

            config EXAMPLE_COZE_AGENT_BOT2_ID
                string "Bot ID"
                default "7516538xxxxxxxxxxxx"

            config EXAMPLE_COZE_AGENT_BOT2_DESCRIPTION
                string "Bot description"
                default "A male AI character with a regional accent. He responds quickly and concisely, but does not perform actions on behalf of the user."

            config EXAMPLE_COZE_AGENT_BOT2_VOICE_ID
                string "Bot voice ID"
                default "7426720361732915209"
        endif
    endif

endmenu
```

## products/ws_meeting_demo/main/Kconfig.projbuild
```kconfig
menu "WS Meeting Demo Configuration"

    config MEETING_WIFI_SSID
        string "WiFi SSID"
        default "myssid"
        help
            WiFi network to connect to on boot.

    config MEETING_WIFI_PASSWORD
        string "WiFi Password"
        default "mypassword"

    config WS_MEETING_API_BASE_URL
        string "ClarityX Voice API base URL"
        default "https://clare.vinex.top/voice-api"

    config WS_MEETING_TOPIC
        string "Default meeting topic"
        default "clare产品讨论"

    config VAD_ENERGY_THRESHOLD
        int "VAD energy threshold (RMS int16)"
        default 500
        range 200 5000

    config VAD_SPEECH_MIN_MS
        int "Minimum speech duration (ms) before silence counts"
        default 600
        range 100 2000

    config VAD_SILENCE_MS
        int "Silence duration (ms) to trigger end_of_speech"
        default 1200
        range 200 5000

endmenu
```

## products/ws_meeting_demo/sdkconfig.defaults
```kconfig
# ESP-IDF 5.5 — ws_meeting_demo defaults (ReSpeaker XVF3800 + XIAO ESP32-S3)
CONFIG_APP_PROJECT_VER_FROM_CONFIG=y
CONFIG_APP_PROJECT_VER="0.1.0"
CONFIG_ESPTOOLPY_FLASHMODE_QIO=y
CONFIG_ESPTOOLPY_FLASHSIZE_8MB=y
CONFIG_PARTITION_TABLE_CUSTOM=y
CONFIG_COMPILER_OPTIMIZATION_PERF=y

# TLS
CONFIG_ESP_TLS_INSECURE=y
CONFIG_ESP_TLS_SKIP_SERVER_CERT_VERIFY=y

# PSRAM (ESP32-S3 Octal)
CONFIG_SPIRAM=y
CONFIG_SPIRAM_MODE_OCT=y
CONFIG_SPIRAM_XIP_FROM_PSRAM=y
CONFIG_SPIRAM_SPEED_80M=y
CONFIG_SPIRAM_MALLOC_ALWAYSINTERNAL=0
CONFIG_SPIRAM_TRY_ALLOCATE_WIFI_LWIP=y
CONFIG_SPIRAM_ALLOW_BSS_SEG_EXTERNAL_MEMORY=y

# CPU / System
CONFIG_ESP_DEFAULT_CPU_FREQ_MHZ_240=y
CONFIG_ESP32S3_DATA_CACHE_LINE_64B=y
CONFIG_ESP_MAIN_TASK_STACK_SIZE=8192
CONFIG_ESP_CONSOLE_USB_SERIAL_JTAG=y
CONFIG_ESP_INT_WDT_TIMEOUT_MS=2000
CONFIG_ESP_TASK_WDT_TIMEOUT_S=10
CONFIG_ESP_TASK_WDT_PANIC=y

# WiFi
CONFIG_ESP_WIFI_DYNAMIC_RX_MGMT_BUFFER=y
CONFIG_ESP_WIFI_TX_BA_WIN=16
CONFIG_ESP_WIFI_RX_BA_WIN=6
CONFIG_ESP_WIFI_PS_NONE=y
CONFIG_MEETING_WIFI_SSID="vine"
CONFIG_MEETING_WIFI_PASSWORD="xyy7608955"

# FreeRTOS
CONFIG_FREERTOS_HZ=1000
CONFIG_FREERTOS_ENABLE_BACKWARD_COMPATIBILITY=y
CONFIG_FREERTOS_TIMER_TASK_STACK_DEPTH=4096

# LwIP
CONFIG_LWIP_TCP_SND_BUF_DEFAULT=65535
CONFIG_LWIP_TCP_RECVMBOX_SIZE=10
CONFIG_LWIP_SNTP_MAX_SERVERS=2
CONFIG_LWIP_DHCP_GET_NTP_SRV=y
CONFIG_LWIP_FALLBACK_DNS_SERVER_SUPPORT=y
CONFIG_LWIP_SO_REUSE=y
CONFIG_LWIP_SO_REUSE_RXTOALL=y
CONFIG_LWIP_MAX_SOCKETS=10
CONFIG_LWIP_TCPIP_RECVMBOX_SIZE=32
CONFIG_LWIP_TCP_KEEPALIVE=y
CONFIG_LWIP_TCP_KEEPIDLE=5
CONFIG_LWIP_TCP_KEEPINTVL=3
CONFIG_LWIP_TCP_KEEPCNT=3

# mbedTLS — reduce RAM
CONFIG_MBEDTLS_EXTERNAL_MEM_ALLOC=y
CONFIG_MBEDTLS_DYNAMIC_BUFFER=y
CONFIG_MBEDTLS_SSL_KEEP_PEER_CERTIFICATE=n

# HTTP client
CONFIG_ESP_HTTP_CLIENT_ENABLE_HTTPS=y
CONFIG_WPA_DEBUG_PRINT=y

# VAD — tighter for demo environment
CONFIG_VAD_ENERGY_THRESHOLD=800
CONFIG_VAD_SPEECH_MIN_MS=300
CONFIG_VAD_SILENCE_MS=600
```
